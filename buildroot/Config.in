## buildroot/Config.in
```kconfig
config BR2_PACKAGE_DIVINUS_WEBUI
	bool "Divinus WebUI static files"
	help
	  Install the WebUI www tree for Divinus to serve.

config BR2_PACKAGE_X86_DIVINUS_FFMPEG
	bool "Divinus UVC FFmpeg support"
	depends on BR2_PACKAGE_DIVINUS
	select BR2_PACKAGE_FFMPEG
	select BR2_PACKAGE_FFMPEG_SWSCALE
	select BR2_PACKAGE_X264
	help
	  Build the local UVC-enabled Divinus with FFmpeg and x264.

config BR2_PACKAGE_DIVINUS_MULTI
	bool "Divinus multi-camera launcher (1-4 UVC devices)"
	depends on BR2_PACKAGE_DIVINUS
	help
	  Start one central Divinus dashboard/API process and camera-backed workers
	  with web_port 0. Missing devices are skipped; no reverse proxy is used.
```

## buildroot/configs/openipc_x86_64_defconfig
```kconfig
BR2_x86_64=y
BR2_TOOLCHAIN_BUILDROOT_GLIBC=y
BR2_TOOLCHAIN_BUILDROOT_CXX=y
BR2_TARGET_GENERIC_HOSTNAME="openipc-x86"
BR2_TARGET_GENERIC_ISSUE="OpenIPC x86 experimental"
BR2_ROOTFS_POST_BUILD_SCRIPT="$(BR2_EXTERNAL_GENERAL_PATH)/scripts/rootfs_script.sh"
BR2_ROOTFS_OVERLAY="$(BR2_EXTERNAL_X86_PATH)/board/overlay"
BR2_OPENIPC_SOC_VENDOR="x86"
BR2_OPENIPC_SOC_MODEL="x86_64"
BR2_OPENIPC_SOC_FAMILY="generic"
BR2_OPENIPC_VARIANT="experimental"
BR2_LINUX_KERNEL=y
BR2_LINUX_KERNEL_CUSTOM_VERSION=y
BR2_LINUX_KERNEL_CUSTOM_VERSION_VALUE="6.6.66"
BR2_LINUX_KERNEL_USE_DEFCONFIG=y
BR2_LINUX_KERNEL_DEFCONFIG="x86_64"
BR2_LINUX_KERNEL_CONFIG_FRAGMENT_FILES="$(BR2_EXTERNAL_X86_PATH)/board/linux.fragment"
BR2_PACKAGE_DIVINUS=y
BR2_PACKAGE_X86_DIVINUS_FFMPEG=y
BR2_PACKAGE_FFMPEG_GPL=y
# BR2_PACKAGE_FFMPEG_FFMPEG is not set
BR2_PACKAGE_FFMPEG_ENCODERS="libx264 mjpeg"
BR2_PACKAGE_FFMPEG_DECODERS="mjpeg"
BR2_PACKAGE_DROPBEAR=y
BR2_SYSTEM_DHCP="eth0"
BR2_TARGET_ROOTFS_EXT2=y
BR2_TARGET_ROOTFS_EXT2_4=y
BR2_TARGET_ROOTFS_EXT2_SIZE="256M"
```
